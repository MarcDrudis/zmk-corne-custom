#include "corne_custom.dtsi"

/*
 * RIGHT HALF (peripheral). Re-soldered wiring.
 * Rows: uiop=P0.10, hjkl;=P0.24, nm,./=P0.31, thumbs=P1.06
 * Cols (outer pinky -> index / col1..col6):
 *   020=outer, 009=p;/, 111=ol., 011=ik,, 113=ujm, 115=yhn
 * Thumbs are on local cols 3,4,5 (ik / ujm / yhn = 011 / 113 / 115).
 * col-offset = <6> maps local cols 0-5 to transform cols 6-11; the shared
 * transform reverses the right half so the keymap stays plain QWERTY.
 */

&default_transform {
	col-offset = <6>;
};

&kscan0 {
	/* ---- col2row (DEFAULT) ---- */
	diode-direction = "col2row";

	row-gpios
		= <&gpio0 10 (GPIO_ACTIVE_HIGH | GPIO_PULL_DOWN)>	/* uiop */
		, <&gpio0 24 (GPIO_ACTIVE_HIGH | GPIO_PULL_DOWN)>	/* hjkl; */
		, <&gpio0 31 (GPIO_ACTIVE_HIGH | GPIO_PULL_DOWN)>	/* nm,./ */
		, <&gpio1 6  (GPIO_ACTIVE_HIGH | GPIO_PULL_DOWN)>	/* thumbs */
		;
	col-gpios
		= <&gpio0 20 GPIO_ACTIVE_HIGH>	/* col1 outer pinky */
		, <&gpio0 9  GPIO_ACTIVE_HIGH>	/* col2 p ; / */
		, <&gpio1 11 GPIO_ACTIVE_HIGH>	/* col3 o l . */
		, <&gpio0 11 GPIO_ACTIVE_HIGH>	/* col4 i k , (thumb2) */
		, <&gpio1 13 GPIO_ACTIVE_HIGH>	/* col5 u j m (thumb1) */
		, <&gpio0 2  GPIO_ACTIVE_HIGH>	/* col6 y h n (thumb0) = 002 */
		;

	/* ---- row2col (ALTERNATE) — uncomment this + comment the block above ----
	diode-direction = "row2col";
	col-gpios
		= <&gpio0 20 (GPIO_ACTIVE_HIGH | GPIO_PULL_DOWN)>
		, <&gpio0 9  (GPIO_ACTIVE_HIGH | GPIO_PULL_DOWN)>
		, <&gpio1 11 (GPIO_ACTIVE_HIGH | GPIO_PULL_DOWN)>
		, <&gpio0 11 (GPIO_ACTIVE_HIGH | GPIO_PULL_DOWN)>
		, <&gpio1 13 (GPIO_ACTIVE_HIGH | GPIO_PULL_DOWN)>
		, <&gpio1 15 (GPIO_ACTIVE_HIGH | GPIO_PULL_DOWN)>
		;
	row-gpios
		= <&gpio0 10 GPIO_ACTIVE_HIGH>
		, <&gpio0 24 GPIO_ACTIVE_HIGH>
		, <&gpio0 31 GPIO_ACTIVE_HIGH>
		, <&gpio1 6  GPIO_ACTIVE_HIGH>
		;
	*/
};
