## config/boards/shields/corne_custom/Kconfig.defconfig
```kconfig
if SHIELD_CORNE_CUSTOM_LEFT

config ZMK_KEYBOARD_NAME
	default "Corne Custom L"

config ZMK_SPLIT_ROLE_CENTRAL
	default y

endif

if SHIELD_CORNE_CUSTOM_LEFT || SHIELD_CORNE_CUSTOM_RIGHT

config ZMK_SPLIT
	default y

endif

if SHIELD_CORNE_CUSTOM_RIGHT

config ZMK_KEYBOARD_NAME
	default "Corne Custom R"

endif
```

## config/boards/shields/corne_custom/Kconfig.shield
```kconfig
config SHIELD_CORNE_CUSTOM_LEFT
	def_bool $(shields_list_contains,corne_custom_left)

config SHIELD_CORNE_CUSTOM_RIGHT
	def_bool $(shields_list_contains,corne_custom_right)
```
